## reference/Kconfig
```kconfig
#
# For a description of the syntax of this configuration file,
# see build/scripts/Documentation/kbuild/kconfig-language.txt.
#

source reference/hal/Kconfig
source reference/common/Kconfig

menu "Scene Configuration"
config SCENEAUTO_SUPPORT
	bool "Sceneauto support"
endmenu

menu "Media Configuration"
	config LDC_SUPPORT
		bool "LDC support"
		help
			Lens Distortion Correction.
endmenu

menu "UI Configuration"
	choice
		prompt "LCD UI Source Adapt Type"
		default LCD_UISRC_ADAPT_MANUAL
		config LCD_UISRC_ADAPT_AUTO
			bool "auto"
		config LCD_UISRC_ADAPT_MANUAL
			bool "manual"
	endchoice
	config LCD_UISRC_BASE_WIDTH
	    string "LCD UI source base width"
	    depends on LCD_UISRC_ADAPT_AUTO
		help
			base width of the UI resource file when the LCD UI resource file adaptation type is Automatic.
    config LCD_UISRC_BASE_HEIGHT
	    string "LCD UI source base height"
	    depends on LCD_UISRC_ADAPT_AUTO
		help
			base height of the UI resource file when the LCD UI resource file adaptation type is Automatic.
    config LCD_UISRC_DEST_WIDTH
	    string "LCD UI source dest width"
	    depends on LCD_UISRC_ADAPT_AUTO
		help
			destination width of the UI resource file when the LCD UI resource file adaptation type is Automatic.
    config LCD_UISRC_DEST_HEIGHT
	    string "LCD UI source dest height"
	    depends on LCD_UISRC_ADAPT_AUTO
		help
			destination height of the UI resource file when the LCD UI resource file adaptation type is Automatic.

endmenu

menu "PARAM Configuration"
config PARAM_DIR_SUFFIX
	string "PARAM DIR SUFFIX"
	help
		suffix of a parameter folder, which is used to distinguish parameter directories of different versions.
endmenu
```

## reference/common/filemng/Kconfig
```kconfig
#
# For a description of the syntax of this configuration file,
# see Documentation/kbuild/kconfig-language.txt.
#

menu "File Manager Configuration"

choice
	prompt "File Management Rule"
	help
		Select File Management Rule

	config DCF
		bool "DCF"
		help
			Design rule for Camera File system
	config DTCF
		bool "DTCF"
		help
			Date-Time rule for Camera File system
endchoice
config SUPPORT_CUSTOM_BACKUP_FILE
		bool "Support custom backup file name"
		help

config SUPPORT_FILE_MARKER
		bool "Support file marker"
		help

endmenu
```

## reference/hal/ahd/Kconfig
```kconfig
#
# For a description of the syntax of this configuration file,
# see Documentation/kbuild/kconfig-language.txt.
#
#comment "Device Configuration"

menuconfig AHD
	bool "AHD support"

if AHD

config AHD_N3
		bool "Support N3"
		help
			whether the hal supports N3.
config AHD_NVP6324
		bool "Support NVP6324"
		help
			whether the hal supports NVP6324.
endif
```

## reference/hal/button/Kconfig
```kconfig
#
# For a description of the syntax of this configuration file,
# see Documentation/kbuild/kconfig-language.txt.
#
#comment "Device Configuration"

menuconfig Button
	bool "Button support"

if Button
	choice
		prompt "Button Type"
		 config Button_Even
			bool "Button_Even"
		if ADC	
	    config Button_ADC
			bool "Button_ADC"
	    endif
	endchoice
endif
```

## reference/hal/gauge/Kconfig
```kconfig
#
# For a description of the syntax of this configuration file,
# see Documentation/kbuild/kconfig-language.txt.
#
#comment "Device Configuration"

menuconfig GAUGE
	bool "GAUGE support"

if GAUGE
	choice
		prompt "GAUGE Type"
		config GAUGE_BQ27421
			bool "bq27421"
			depends on (HI3556AV100 && CONFIG_REFB_ACTIONCAM)
		 config GAUGE_CW2015
			bool "cw2015"
		 config GAUGE_MAX17201
			bool "MAX17201"
		if ADC	
	    config GAUGE_ADC
			bool "GAUGE_ADC"
	    endif
	endchoice
endif
```

## reference/hal/wifi/Kconfig
```kconfig
#
# For a description of the syntax of this configuration file,
# see Documentation/kbuild/kconfig-language.txt.
#
#comment "Device Configuration"

menuconfig WIFI
	bool "WIFI support"

if WIFI
	choice
		prompt "WIFI Type"
		config WIFI_RTL8189
			bool "rtl8189"
			depends on (HI3559V200 || HI3556V200 || HI3518EV300 || HI3519AV100)
	endchoice
endif
```
